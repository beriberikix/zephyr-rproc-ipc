## Kconfig
```kconfig
# SPDX-License-Identifier: Apache-2.0

menu "Remoteproc IPC (out-of-tree)"

rsource "drivers/remoteproc/Kconfig"
rsource "subsys/ipc/ipc_service/backends/Kconfig.rproc_rpmsg"
rsource "subsys/mgmt/mcumgr/transport/Kconfig.ipc"
rsource "tests/common/Kconfig"

endmenu
```

## build/rpmsg_echo/Kconfig/Kconfig.modules
```kconfig
menu "pouch (/home/jonathan.beri@canonical.com/code/modules/lib/pouch)"
osource "/home/jonathan.beri@canonical.com/code/modules/lib/pouch/port/zephyr/Kconfig"
config ZEPHYR_POUCH_MODULE
	bool
	default y
endmenu
menu "cmsis (/home/jonathan.beri@canonical.com/code/modules/hal/cmsis)"
osource "$(ZEPHYR_CMSIS_KCONFIG)"
config ZEPHYR_CMSIS_MODULE
	bool
	default y
endmenu
menu "cmsis_6 (/home/jonathan.beri@canonical.com/code/modules/hal/cmsis_6)"
osource "$(ZEPHYR_CMSIS_6_KCONFIG)"
config ZEPHYR_CMSIS_6_MODULE
	bool
	default y
endmenu
menu "hal_nordic (/home/jonathan.beri@canonical.com/code/modules/hal/nordic)"
osource "$(ZEPHYR_HAL_NORDIC_KCONFIG)"
config ZEPHYR_HAL_NORDIC_MODULE
	bool
	default y

config ZEPHYR_HAL_NORDIC_MODULE_BLOBS
	bool
endmenu
menu "hal_nxp (/home/jonathan.beri@canonical.com/code/modules/hal/nxp)"
osource "$(ZEPHYR_HAL_NXP_KCONFIG)"
config ZEPHYR_HAL_NXP_MODULE
	bool
	default y

config ZEPHYR_HAL_NXP_MODULE_BLOBS
	bool
endmenu
config ZEPHYR_LIBMETAL_MODULE
	bool
	default y
menu "littlefs (/home/jonathan.beri@canonical.com/code/modules/fs/littlefs)"
osource "$(ZEPHYR_LITTLEFS_KCONFIG)"
config ZEPHYR_LITTLEFS_MODULE
	bool
	default y
endmenu
menu "mbedtls (/home/jonathan.beri@canonical.com/code/modules/crypto/mbedtls)"
osource "$(ZEPHYR_MBEDTLS_KCONFIG)"
config ZEPHYR_MBEDTLS_MODULE
	bool
	default y
endmenu
config ZEPHYR_MCUBOOT_MODULE
	bool
	default y
config ZEPHYR_OPEN_AMP_MODULE
	bool
	default y
menu "picolibc (/home/jonathan.beri@canonical.com/code/modules/lib/picolibc)"
osource "/home/jonathan.beri@canonical.com/code/modules/lib/picolibc/zephyr/Kconfig"
config ZEPHYR_PICOLIBC_MODULE
	bool
	default y
endmenu
menu "segger (/home/jonathan.beri@canonical.com/code/modules/debug/segger)"
osource "$(ZEPHYR_SEGGER_KCONFIG)"
config ZEPHYR_SEGGER_MODULE
	bool
	default y
endmenu
config ZEPHYR_TF_PSA_CRYPTO_MODULE
	bool
	default y
menu "trusted-firmware-m (/home/jonathan.beri@canonical.com/code/modules/tee/tf-m/trusted-firmware-m)"
osource "$(ZEPHYR_TRUSTED_FIRMWARE_M_KCONFIG)"
config ZEPHYR_TRUSTED_FIRMWARE_M_MODULE
	bool
	default y
endmenu
menu "zcbor (/home/jonathan.beri@canonical.com/code/modules/lib/zcbor)"
osource "$(ZEPHYR_ZCBOR_KCONFIG)"
config ZEPHYR_ZCBOR_MODULE
	bool
	default y
endmenu
menu "zephyr-rproc-ipc (/home/jonathan.beri@canonical.com/code/zephyr-rproc-ipc)"
osource "/home/jonathan.beri@canonical.com/code/zephyr-rproc-ipc/Kconfig"
config ZEPHYR_ZEPHYR_RPROC_IPC_MODULE
	bool
	default y
endmenu
config ZEPHYR_NRF_HW_MODELS_MODULE
	bool
	default y
```

## build/rpmsg_echo/Kconfig/Kconfig.shield
```kconfig
osource "/home/jonathan.beri@canonical.com/code/modules/lib/pouch/boards/shields/*/Kconfig.shield"
```

## build/rpmsg_echo/Kconfig/Kconfig.sysbuild.modules
```kconfig
config ZEPHYR_POUCH_MODULE
   bool
   default y
config ZEPHYR_CMSIS_MODULE
   bool
   default y
config ZEPHYR_CMSIS_6_MODULE
   bool
   default y
config ZEPHYR_HAL_NORDIC_MODULE
   bool
   default y
config ZEPHYR_HAL_NXP_MODULE
   bool
   default y
config ZEPHYR_LIBMETAL_MODULE
   bool
   default y
config ZEPHYR_LITTLEFS_MODULE
   bool
   default y
config ZEPHYR_MBEDTLS_MODULE
   bool
   default y
config ZEPHYR_MCUBOOT_MODULE
   bool
   default y
config ZEPHYR_OPEN_AMP_MODULE
   bool
   default y
config ZEPHYR_PICOLIBC_MODULE
   bool
   default y
config ZEPHYR_SEGGER_MODULE
   bool
   default y
config ZEPHYR_TF_PSA_CRYPTO_MODULE
   bool
   default y
config ZEPHYR_TRUSTED_FIRMWARE_M_MODULE
   bool
   default y
config ZEPHYR_ZCBOR_MODULE
   bool
   default y
config ZEPHYR_ZEPHYR_RPROC_IPC_MODULE
   bool
   default y
config ZEPHYR_NRF_HW_MODELS_MODULE
   bool
   default y
```

## build/rpmsg_echo/Kconfig/arch/Kconfig
```kconfig
# Load Zephyr Arch Kconfig descriptions.
osource "/home/jonathan.beri@canonical.com/code/zephyr/arch/rx/Kconfig"
osource "/home/jonathan.beri@canonical.com/code/zephyr/arch/x86/Kconfig"
osource "/home/jonathan.beri@canonical.com/code/zephyr/arch/xtensa/Kconfig"
osource "/home/jonathan.beri@canonical.com/code/zephyr/arch/sparc/Kconfig"
osource "/home/jonathan.beri@canonical.com/code/zephyr/arch/riscv/Kconfig"
osource "/home/jonathan.beri@canonical.com/code/zephyr/arch/posix/Kconfig"
osource "/home/jonathan.beri@canonical.com/code/zephyr/arch/openrisc/Kconfig"
osource "/home/jonathan.beri@canonical.com/code/zephyr/arch/mips/Kconfig"
osource "/home/jonathan.beri@canonical.com/code/zephyr/arch/arm64/Kconfig"
osource "/home/jonathan.beri@canonical.com/code/zephyr/arch/arm/Kconfig"
osource "/home/jonathan.beri@canonical.com/code/zephyr/arch/arc/Kconfig"
```

## build/rpmsg_echo/Kconfig/boards/Kconfig.defconfig
```kconfig
# Load Zephyr board defconfig descriptions.
osource "/home/jonathan.beri@canonical.com/code/zephyr/boards/nxp/imx95_evk/Kconfig.defconfig"
```

## build/rpmsg_echo/Kconfig/boards/Kconfig.imx95_evk
```kconfig
# Load board Kconfig descriptions.
osource "/home/jonathan.beri@canonical.com/code/zephyr/boards/nxp/imx95_evk/Kconfig.imx95_evk"
```

## build/rpmsg_echo/Kconfig/boards/Kconfig.sysbuild
```kconfig
# Load Sysbuild board Kconfig descriptions.
osource "/home/jonathan.beri@canonical.com/code/zephyr/boards/nxp/imx95_evk/Kconfig.sysbuild"
```

## dts/bindings/ipc/zephyr,ipc-loopback.yaml
```yaml
# SPDX-License-Identifier: Apache-2.0

description: |
  Test-only IPC service backend that delivers messages on a worker thread.

  Two instances sharing a "link-id" are paired: what one sends, the other
  receives. An instance whose link-id is unique echoes to its own endpoint.
  Pairing is by id rather than by phandle because two nodes pointing at each
  other form a devicetree dependency cycle, which leaves both without an
  ordinal and fails the build.

  Delivery never happens on the sender's thread, which matters for anything
  built on request/response: a synchronous loopback would re-enter the caller
  while it still holds its transmit lock.

compatible: "zephyr,ipc-loopback"

include: base.yaml

properties:
  link-id:
    type: int
    required: true
    description: Instances sharing this id are paired with each other.

  mtu:
    type: int
    default: 496
    description: Largest message this link carries, as rpmsg's 512-byte buffers give 496.
```

## dts/bindings/ipc/zephyr,ipc-rproc-rpmsg.yaml
```yaml
# SPDX-License-Identifier: Apache-2.0

description: |
  IPC service backend over the RPMsg virtio device of an OpenAMP remoteproc
  remote.

  Use it on a core that a host - typically Linux, through remoteproc and
  virtio_rpmsg_bus - loads and sets up from the core's resource table. The
  virtio device, its vrings and the resource table are described by the
  openamp,rpmsg-virtio-device node this refers to; this node only exposes that
  device through the IPC service API.

  Endpoints are announced through the RPMsg name service under the name they
  are registered with; Linux binds the name "rpmsg-raw" to rpmsg_char, which
  creates /dev/rpmsgN. An endpoint is bound when the host first sends it a
  message, since only then is the host's address known.

  Endpoint callbacks run on the RPMsg device's receive thread, whose priority
  is set by RPMSG_VDEV_THREAD_PRIORITY.

compatible: "zephyr,ipc-rproc-rpmsg"

include: base.yaml

properties:
  rpmsg-device:
    type: phandle
    required: true
    description: The openamp,rpmsg-virtio-device node this instance uses.
```

## dts/bindings/remoteproc/openamp,resource-table.yaml
```yaml
# Copyright (c) 2024 Maurer Systems GmbH
# SPDX-License-Identifier: Apache-2.0

description: |
  Binding for describing the remoteproc resource table used by OpenAMP.

  The resource table defines shared memory regions and virtio devices
  required for inter-processor communication.

compatible: "openamp,resource-table"

properties:
  carveouts:
    type: phandles
    required: true
    description: |
      Phandles to memory regions reserved as carveouts for shared memory
      used by OpenAMP.

  vdevs:
    type: phandles
    required: true
    description: |
      Phandles to virtio device nodes associated with the OpenAMP
      resource table.

  memory-region:
    type: phandle
    description: |
      Phandle to a memory region the resource table is copied into before
      first use. Set it when the host reads and updates the table at a fixed
      address rather than where the image linked it - Linux's i.MX
      remoteproc driver does, at its "rsc-table" reserved-memory node - so
      that the remote sees the virtio device status the host writes there.
      Without it the table is used in place.
```

## subsys/ipc/ipc_service/backends/Kconfig.rproc_rpmsg
```kconfig
# SPDX-License-Identifier: Apache-2.0

config IPC_SERVICE_BACKEND_RPROC_RPMSG
	bool "OpenAMP remoteproc RPMsg backend"
	default y
	depends on IPC_SERVICE
	depends on OPENAMP_RPMSG_VDEV
	depends on DT_HAS_ZEPHYR_IPC_RPROC_RPMSG_ENABLED
	help
	  IPC service backend over the RPMsg virtio device of a remoteproc
	  remote: a core whose host, typically Linux, loads it and sets up the
	  virtio device from its resource table. Endpoints are announced
	  through the RPMsg name service.

if IPC_SERVICE_BACKEND_RPROC_RPMSG

config IPC_SERVICE_BACKEND_RPROC_RPMSG_NUM_ENDPOINTS
	int "Endpoints per instance"
	default 2
	help
	  Maximum number of endpoints registered on one instance.

config IPC_SERVICE_BACKEND_RPROC_RPMSG_TX_WAIT_MS
	int "Transmit buffer wait (ms)"
	default 100
	help
	  How long ipc_service_send() waits for a free transmit buffer before
	  returning -ENOMEM. The wait polls the used ring and needs no other
	  thread, so it is safe from a received() callback, but it does delay
	  whatever called it.

endif # IPC_SERVICE_BACKEND_RPROC_RPMSG
```

## subsys/mgmt/mcumgr/transport/Kconfig.ipc
```kconfig
# SPDX-License-Identifier: Apache-2.0

# Kconfig macro arguments cannot contain commas.
DT_CHOSEN_Z_IPC_MCUMGR := zephyr,ipc-mcumgr

menuconfig MCUMGR_TRANSPORT_IPC
	bool "IPC service MCUmgr SMP transport"
	depends on MCUMGR
	depends on IPC_SERVICE
	depends on $(dt_chosen_enabled,$(DT_CHOSEN_Z_IPC_MCUMGR))
	select MCUMGR_TRANSPORT_REASSEMBLY
	help
	  Carry MCUmgr SMP packets over one endpoint of the IPC service
	  instance chosen as zephyr,ipc-mcumgr, with no framing beyond the SMP
	  header. Packets longer than one IPC message are split and rejoined,
	  so MCUMGR_TRANSPORT_NETBUF_SIZE, not the backend's buffer size,
	  bounds the packet size.

if MCUMGR_TRANSPORT_IPC

config MCUMGR_TRANSPORT_IPC_ENDPOINT_NAME
	string "Endpoint name"
	default "mcumgr"
	help
	  Name the SMP endpoint is registered under. For RPMsg to a Linux host
	  this is the channel name the host sees; give it a name of its own so
	  the host can tell it apart from other endpoints on the same link.

config MCUMGR_TRANSPORT_IPC_TX_WAIT_MS
	int "Transmit buffer wait (ms)"
	default 1000
	help
	  How long each outgoing fragment waits for the peer to free a
	  transmit buffer before the response is abandoned.

module = MCUMGR_TRANSPORT_IPC
module-str = MCUmgr IPC transport
source "subsys/logging/Kconfig.template.log_config"

endif # MCUMGR_TRANSPORT_IPC
```

## tests/common/Kconfig
```kconfig
# SPDX-License-Identifier: Apache-2.0

menuconfig IPC_LOOPBACK
	bool "Loopback IPC service backend (test only)"
	depends on IPC_SERVICE
	depends on DT_HAS_ZEPHYR_IPC_LOOPBACK_ENABLED
	help
	  A backend that delivers messages on a worker thread instead of the
	  sender's, optionally to a paired instance. It lets code built on the
	  IPC service - including request/response layers that send while
	  holding a lock - be tested on native_sim with no hardware.

if IPC_LOOPBACK

config IPC_LOOPBACK_MAX_MTU
	int "Largest message any instance carries"
	default 496

config IPC_LOOPBACK_QUEUE_LEN
	int "Messages buffered per instance"
	default 8

config IPC_LOOPBACK_STACK_SIZE
	int "Delivery thread stack size"
	default 2048

config IPC_LOOPBACK_THREAD_PRIORITY
	int "Delivery thread priority"
	default 5

endif # IPC_LOOPBACK
```
